## Kconfig
```kconfig
menu "LeonOS 4"

menu "Build"

config VMDK_REQUIRE_LICENSE
    bool "Standalone VMDK requires license activation"
    default y

config INSTALLER_INSTALLED_REQUIRE_LICENSE
    bool "Installed system from installer ISO requires license activation"
    default y

config IMAGE_SIZE_MIB
    int "Standalone VMDK image size in MiB"
    range 64 4096
    default 96

config INSTALLER_ROOT_SIZE_MIB
    int "Installer runtime root size in MiB"
    range 32 4096
    default 64

endmenu

menu "QEMU Run"

config QEMU_MEMORY_MB
    int "QEMU memory size in MiB"
    range 128 65536
    default 512

config QEMU_DISPLAY_WIDTH
    int "QEMU VGA display width"
    range 640 7680
    default 1920

config QEMU_DISPLAY_HEIGHT
    int "QEMU VGA display height"
    range 480 4320
    default 1080

config QEMU_ENABLE_KVM
    bool "Enable KVM acceleration for QEMU run targets"
    default y

config QEMU_NET_DEVICE
    string "QEMU network device model"
    default "e1000"
    help
      Leave empty to disable QEMU user networking for run targets.

config QEMU_OVMF_PATH
    string "QEMU OVMF firmware path"
    default "/usr/share/ovmf/OVMF.fd"

endmenu

menu "System Configuration"

config LICENSE_SERVER_URL
    string "License platform URL"
    default "http://127.0.0.1:30301"

config LICENSE_DEBUG_LOG
    bool "Enable license and OOBE activation debug logs"
    default y

endmenu

endmenu
```
